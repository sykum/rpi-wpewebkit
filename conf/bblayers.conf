## conf/bblayers.conf
```bitbake
# POKY_BBLAYERS_CONF_VERSION is increased each time build/conf/bblayers.conf
# changes incompatibly
POKY_BBLAYERS_CONF_VERSION = "2"

BBPATH = "${TOPDIR}"
BBFILES ?= ""

BBLAYERS ?= " \
  /home/rseidt/poky/meta \
  /home/rseidt/poky/meta-poky \
  /home/rseidt/poky/meta-yocto-bsp \
  /home/rseidt/poky/meta-openembedded/meta-oe \
  /home/rseidt/poky/meta-openembedded/meta-networking \
  /home/rseidt/poky/meta-openembedded/meta-multimedia \
  /home/rseidt/poky/meta-openembedded/meta-python \
  /home/rseidt/poky/meta-raspberrypi \
  /home/rseidt/poky/meta-webkit \
  "
```
